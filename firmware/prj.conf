## CMakeLists.txt
```
cmake_minimum_required(VERSION 3.20.0)

find_package(Zephyr REQUIRED HINTS $ENV{ZEPHYR_BASE})

project(cpp_embedded_telemetry_firmware LANGUAGES C CXX)

get_filename_component(PROJECT_ROOT "${CMAKE_CURRENT_LIST_DIR}/.." ABSOLUTE)

target_sources(
    app
    PRIVATE
        src/deterministic_sensor_model.cpp
        src/firmware_metrics.cpp
        src/hex_formatter.cpp
        src/main.cpp
        src/telemetry_producer.cpp
        src/telemetry_queue.cpp
        src/telemetry_transmitter.cpp
        ${PROJECT_ROOT}/protocol/src/crc32.cpp
        ${PROJECT_ROOT}/protocol/src/deserializer.cpp
        ${PROJECT_ROOT}/protocol/src/serializer.cpp
)

target_include_directories(
    app
    PRIVATE
        include
        ${PROJECT_ROOT}/protocol/include
)

target_compile_features(app PRIVATE cxx_std_20)

target_compile_options(
    app
    PRIVATE
        $<$<COMPILE_LANGUAGE:CXX>:
            -Wall
            -Wextra
            -Wformat=2
            -Werror
            -ffile-prefix-map=${PROJECT_ROOT}=PROJECT_ROOT
        >
)

set(
    STRICT_CXX_SOURCES
    src/deterministic_sensor_model.cpp
    src/firmware_metrics.cpp
    src/hex_formatter.cpp
    src/telemetry_producer.cpp
    ${PROJECT_ROOT}/protocol/src/crc32.cpp
    ${PROJECT_ROOT}/protocol/src/deserializer.cpp
    ${PROJECT_ROOT}/protocol/src/serializer.cpp
)

set_source_files_properties(
    ${STRICT_CXX_SOURCES}
    PROPERTIES
        COMPILE_OPTIONS
            "-Wpedantic;-Wconversion;-Wsign-conversion;-Wshadow;-Wundef"
)
```

## prj.conf
```kconfig
CONFIG_CPP=y
CONFIG_STD_CPP20=y
CONFIG_REQUIRES_FULL_LIBCPP=y
CONFIG_CPP_EXCEPTIONS=n
CONFIG_CPP_RTTI=n

CONFIG_MULTITHREADING=y
CONFIG_CONSOLE=y
CONFIG_PRINTK=y
CONFIG_THREAD_NAME=y
CONFIG_ASSERT=y

CONFIG_MAIN_STACK_SIZE=4096
CONFIG_HEAP_MEM_POOL_SIZE=0
```

## src/main.cpp
```c
#include "telemetry_firmware/deterministic_sensor_model.hpp"
#include "telemetry_firmware/firmware_metrics.hpp"
#include "telemetry_firmware/telemetry_producer.hpp"
#include "telemetry_firmware/telemetry_queue.hpp"
#include "telemetry_firmware/telemetry_transmitter.hpp"

#include <zephyr/kernel.h>
#include <zephyr/sys/printk.h>

#if defined(CONFIG_BOARD_NATIVE_SIM)
#include <nsi_main.h>
#endif

#include <cstddef>
#include <cstdint>

namespace {

constexpr std::size_t producer_stack_size{2'048U};
constexpr std::size_t transmitter_stack_size{2'048U};
constexpr int producer_priority{5};
constexpr int transmitter_priority{4};

K_THREAD_STACK_DEFINE(producer_stack, producer_stack_size);
K_THREAD_STACK_DEFINE(transmitter_stack, transmitter_stack_size);
struct k_thread producer_thread_data;
struct k_thread transmitter_thread_data;
K_SEM_DEFINE(producer_finished, 0, 1);
K_SEM_DEFINE(transmitter_finished, 0, 1);

struct ProducerThreadContext {
    telemetry::firmware::TelemetryProducer* producer{};
    bool succeeded{};
};

struct TransmitterThreadContext {
    telemetry::firmware::TelemetryTransmitter* transmitter{};
    bool succeeded{};
};

void producer_thread_entry(void* first, void*, void*) {
    auto* const context{static_cast<ProducerThreadContext*>(first)};
    context->succeeded = context->producer->run();
    k_sem_give(&producer_finished);
}

void transmitter_thread_entry(void* first, void*, void*) {
    auto* const context{static_cast<TransmitterThreadContext*>(first)};
    context->succeeded = context->transmitter->run();
    k_sem_give(&transmitter_finished);
}

bool metrics_are_valid(
    const telemetry::firmware::FirmwareMetricsSnapshot& metrics) noexcept {
    return metrics.samples_generated ==
               telemetry::firmware::deterministic_sample_count &&
           metrics.frames_serialized ==
               telemetry::firmware::deterministic_sample_count &&
           metrics.frames_enqueued ==
               telemetry::firmware::deterministic_sample_count &&
           metrics.frames_transmitted ==
               telemetry::firmware::deterministic_sample_count &&
           metrics.queue_push_failures == 0U &&
           metrics.queue_pop_failures == 0U &&
           metrics.end_markers_sent == 1U &&
           metrics.end_markers_received == 1U;
}

}  // namespace

int main() {
    telemetry::firmware::DeterministicSensorModel sensor_model{};
    telemetry::firmware::TelemetryQueue queue{};
    telemetry::firmware::FirmwareMetrics metrics{};
    telemetry::firmware::TelemetryProducer producer{
        sensor_model, queue, metrics};
    telemetry::firmware::TelemetryTransmitter transmitter{queue, metrics};
    ProducerThreadContext producer_context{.producer = &producer};
    TransmitterThreadContext transmitter_context{.transmitter = &transmitter};

    k_tid_t transmitter_id{k_thread_create(
        &transmitter_thread_data,
        transmitter_stack,
        K_THREAD_STACK_SIZEOF(transmitter_stack),
        transmitter_thread_entry,
        &transmitter_context,
        nullptr,
        nullptr,
        transmitter_priority,
        0,
        K_NO_WAIT)};
    k_tid_t producer_id{k_thread_create(
        &producer_thread_data,
        producer_stack,
        K_THREAD_STACK_SIZEOF(producer_stack),
        producer_thread_entry,
        &producer_context,
        nullptr,
        nullptr,
        producer_priority,
        0,
        K_NO_WAIT)};

    (void)k_thread_name_set(transmitter_id, "telemetry_tx");
    (void)k_thread_name_set(producer_id, "telemetry_producer");

    (void)k_sem_take(&producer_finished, K_FOREVER);
    (void)k_sem_take(&transmitter_finished, K_FOREVER);

    const telemetry::firmware::FirmwareMetricsSnapshot final_metrics{
        metrics.snapshot()};
    const std::uint64_t queue_errors{
        final_metrics.queue_push_failures +
        final_metrics.queue_pop_failures};
    const bool succeeded{
        producer_context.succeeded && transmitter_context.succeeded &&
        metrics_are_valid(final_metrics) && queue.empty()};

    if (!succeeded) {
        printk(
            "TLFIRMWARE ERROR produced=%llu transmitted=%llu "
            "queue_errors=%llu\n",
            static_cast<unsigned long long>(final_metrics.frames_enqueued),
            static_cast<unsigned long long>(final_metrics.frames_transmitted),
            static_cast<unsigned long long>(queue_errors));
    } else {
        printk(
            "TLFIRMWARE SUMMARY produced=%llu transmitted=%llu "
            "queue_errors=%llu\n",
            static_cast<unsigned long long>(final_metrics.frames_enqueued),
            static_cast<unsigned long long>(final_metrics.frames_transmitted),
            static_cast<unsigned long long>(queue_errors));
        printk("TLFIRMWARE DONE\n");
    }

    const int exit_code{succeeded ? 0 : 1};
#if defined(CONFIG_BOARD_NATIVE_SIM)
    nsi_exit(exit_code);
#else
    return exit_code;
#endif
}
```

## src/deterministic_sensor_model.cpp
```c
#include "telemetry_firmware/deterministic_sensor_model.hpp"

#include <array>
#include <cstddef>
#include <cstdint>

namespace telemetry::firmware {
namespace {

constexpr std::uint16_t flag_value(
    const telemetry::protocol::StatusFlag flag) noexcept {
    return static_cast<std::uint16_t>(flag);
}

constexpr std::uint16_t combine_flags(
    const telemetry::protocol::StatusFlag first,
    const telemetry::protocol::StatusFlag second) noexcept {
    return static_cast<std::uint16_t>(flag_value(first) | flag_value(second));
}

constexpr std::array<telemetry::protocol::TelemetrySample,
                     deterministic_sample_count>
    samples{{
        {-5'500, 98'500U, 2'900U, flag_value(telemetry::protocol::StatusFlag::none)},
        {0, 100'000U, 3'300U,
         flag_value(telemetry::protocol::StatusFlag::sensor_warning)},
        {12'500, 100'800U, 3'150U,
         flag_value(telemetry::protocol::StatusFlag::voltage_warning)},
        {23'000, 101'325U, 3'300U,
         flag_value(telemetry::protocol::StatusFlag::communication_warning)},
        {31'500, 102'100U, 3'250U,
         flag_value(telemetry::protocol::StatusFlag::watchdog_event)},
        {45'000, 99'500U, 2'800U,
         combine_flags(
             telemetry::protocol::StatusFlag::sensor_warning,
             telemetry::protocol::StatusFlag::voltage_warning)},
        {18'500, 100'500U, 3'000U,
         combine_flags(
             telemetry::protocol::StatusFlag::communication_warning,
             telemetry::protocol::StatusFlag::watchdog_event)},
        {27'000, 101'800U, 3'350U,
         flag_value(telemetry::protocol::StatusFlag::none)},
    }};

}  // namespace

bool DeterministicSensorModel::has_next() const noexcept {
    return next_index_ < samples.size();
}

telemetry::protocol::TelemetryFrame DeterministicSensorModel::next() noexcept {
    if (!has_next()) {
        return {};
    }

    const std::size_t current_index{next_index_};
    ++next_index_;

    return telemetry::protocol::TelemetryFrame{
        .header =
            {
                .version = telemetry::protocol::supported_version,
                .message_type = telemetry::protocol::supported_message_type,
                .payload_size = telemetry::protocol::telemetry_payload_size,
                .sequence =
                    initial_sequence + static_cast<std::uint32_t>(current_index),
                .timestamp_microseconds =
                    initial_timestamp_microseconds +
                    (static_cast<std::uint64_t>(current_index) *
                     timestamp_increment_microseconds),
            },
        .payload = samples[current_index],
    };
}

std::size_t DeterministicSensorModel::remaining() const noexcept {
    return samples.size() - next_index_;
}

}  // namespace telemetry::firmware
```

## src/firmware_metrics.cpp
```c
#include "telemetry_firmware/firmware_metrics.hpp"

namespace telemetry::firmware {

void FirmwareMetrics::record_sample_generated() noexcept {
    ++values_.samples_generated;
}

void FirmwareMetrics::record_frame_serialized() noexcept {
    ++values_.frames_serialized;
}

void FirmwareMetrics::record_frame_enqueued() noexcept {
    ++values_.frames_enqueued;
}

void FirmwareMetrics::record_frame_transmitted() noexcept {
    ++values_.frames_transmitted;
}

void FirmwareMetrics::record_queue_push_failure() noexcept {
    ++values_.queue_push_failures;
}

void FirmwareMetrics::record_queue_pop_failure() noexcept {
    ++values_.queue_pop_failures;
}

void FirmwareMetrics::record_end_marker_sent() noexcept {
    ++values_.end_markers_sent;
}

void FirmwareMetrics::record_end_marker_received() noexcept {
    ++values_.end_markers_received;
}

FirmwareMetricsSnapshot FirmwareMetrics::snapshot() const noexcept {
    return values_;
}

}  // namespace telemetry::firmware
```

## src/hex_formatter.cpp
```c
#include "telemetry_firmware/hex_formatter.hpp"

#include <cstddef>
#include <cstdint>

namespace telemetry::firmware {
namespace {

constexpr char hexadecimal_digits[]{"0123456789ABCDEF"};

}  // namespace

HexFormatter::Buffer HexFormatter::format(
    const telemetry::protocol::SerializedFrame& frame) noexcept {
    Buffer output{};

    for (std::size_t index{0U}; index < frame.size(); ++index) {
        const std::uint8_t byte{frame[index]};
        output[index * 2U] = hexadecimal_digits[byte >> 4U];
        output[(index * 2U) + 1U] = hexadecimal_digits[byte & 0x0FU];
    }

    output[hexadecimal_frame_length] = '\0';
    return output;
}

}  // namespace telemetry::firmware
```

## src/telemetry_producer.cpp
```c
#include "telemetry_firmware/telemetry_producer.hpp"

#include "telemetry_protocol/serializer.hpp"

namespace telemetry::firmware {

TelemetryProducer::TelemetryProducer(
    DeterministicSensorModel& sensor_model,
    TelemetryQueue& queue,
    FirmwareMetrics& metrics) noexcept
    : sensor_model_{sensor_model}, queue_{queue}, metrics_{metrics} {}

bool TelemetryProducer::run() noexcept {
    while (sensor_model_.has_next()) {
        const telemetry::protocol::TelemetryFrame frame{sensor_model_.next()};
        metrics_.record_sample_generated();

        const telemetry::protocol::SerializedFrame serialized{
            telemetry::protocol::serialize(frame)};
        metrics_.record_frame_serialized();

        if (!queue_.push_frame(serialized)) {
            metrics_.record_queue_push_failure();
            return false;
        }
        metrics_.record_frame_enqueued();
    }

    if (!queue_.push_end_of_stream()) {
        metrics_.record_queue_push_failure();
        return false;
    }
    metrics_.record_end_marker_sent();
    return true;
}

}  // namespace telemetry::firmware
```

## src/telemetry_queue.cpp
```c
#include "telemetry_firmware/telemetry_queue.hpp"

#include "telemetry_firmware/firmware_types.hpp"

#include <zephyr/kernel.h>

#include <cstddef>

namespace telemetry::firmware {
namespace {

K_MSGQ_DEFINE(
    firmware_message_queue,
    sizeof(TelemetryQueueItem),
    telemetry_queue_capacity,
    4);

}  // namespace

TelemetryQueue::TelemetryQueue() noexcept {
    k_msgq_purge(&firmware_message_queue);
}

bool TelemetryQueue::push_frame(
    const telemetry::protocol::SerializedFrame& frame) noexcept {
    const TelemetryQueueItem item{
        .kind = QueueItemKind::frame,
        .bytes = frame,
    };
    return k_msgq_put(&firmware_message_queue, &item, K_FOREVER) == 0;
}

bool TelemetryQueue::push_end_of_stream() noexcept {
    const TelemetryQueueItem item{
        .kind = QueueItemKind::end_of_stream,
        .bytes = {},
    };
    return k_msgq_put(&firmware_message_queue, &item, K_FOREVER) == 0;
}

bool TelemetryQueue::pop(TelemetryQueueItem& item) noexcept {
    return k_msgq_get(&firmware_message_queue, &item, K_FOREVER) == 0;
}

bool TelemetryQueue::empty() const noexcept {
    return k_msgq_num_used_get(&firmware_message_queue) == 0U;
}

}  // namespace telemetry::firmware
```

## src/telemetry_transmitter.cpp
```c
#include "telemetry_firmware/telemetry_transmitter.hpp"

#include "telemetry_firmware/firmware_types.hpp"
#include "telemetry_firmware/hex_formatter.hpp"

#include <zephyr/sys/printk.h>

#include <cstdint>

namespace telemetry::firmware {

TelemetryTransmitter::TelemetryTransmitter(
    TelemetryQueue& queue,
    FirmwareMetrics& metrics) noexcept
    : queue_{queue}, metrics_{metrics} {}

bool TelemetryTransmitter::run() noexcept {
    std::uint32_t transmission_index{0U};

    while (true) {
        TelemetryQueueItem item{};
        if (!queue_.pop(item)) {
            metrics_.record_queue_pop_failure();
            return false;
        }

        if (item.kind == QueueItemKind::end_of_stream) {
            metrics_.record_end_marker_received();
            return true;
        }

        ++transmission_index;
        const HexFormatter::Buffer hexadecimal{HexFormatter::format(item.bytes)};
        printk(
            "TLFRAME %04u %s\n",
            static_cast<unsigned int>(transmission_index),
            hexadecimal.data());
        metrics_.record_frame_transmitted();
    }
}

}  // namespace telemetry::firmware
```
